// auryl_left.overlay

#include "auryl.dtsi" // Notice that the main dtsi files are included in the overlay.

&kscan0 {
    col-gpios
        = <&pro_micro 8 GPIO_ACTIVE_HIGH> // col1 in the schematic
        , <&pro_micro 9 GPIO_ACTIVE_HIGH> // col2 in the schematic
        , <&pro_micro 10 GPIO_ACTIVE_HIGH> // col3 in the schematic
        , <&pro_micro 16 GPIO_ACTIVE_HIGH> // col4 in the schematic
        , <&pro_micro 14 GPIO_ACTIVE_HIGH> // col5 in the schematic
        , <&pro_micro 15 GPIO_ACTIVE_HIGH> // col6 in the schematic
        ;
};

// &left_encoder {
//     status = "okay";
// };
