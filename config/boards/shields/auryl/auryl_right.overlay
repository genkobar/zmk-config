// auryl_right.overlay

#include "auryl.dtsi"

&default_transform { // The matrix transform for this board is 6 columns over because the left half is 6 columns wide according to the matrix.
    col-offset = <6>;
};

&kscan0 {
    col-gpios
        = <&pro_micro 15 GPIO_ACTIVE_HIGH> // col6 in the schematic
        , <&pro_micro 14 GPIO_ACTIVE_HIGH> // col5 in the schematic
        , <&pro_micro 16 GPIO_ACTIVE_HIGH> // col4 in the schematic
        , <&pro_micro 10 GPIO_ACTIVE_HIGH> // col3 in the schematic
        , <&pro_micro 9 GPIO_ACTIVE_HIGH>  // col2 in the schematic
        , <&pro_micro 8 GPIO_ACTIVE_HIGH>  // col1 in the schematic
        ;
};

// &right_encoder {
    // status = "okay";
// };

// &pro_micro_i2c {
// 	status = "okay";

// 	trackball_pim447@a {
// 		compatible = "pimoroni,trackball_pim447";
// 		reg = <0xa>;
// 		label = "TRACKBALL_PIM447";
// 	};
// };
