## config/boards/shields/auryl/Kconfig.defconfig
```kconfig
# Copyright (c) 2021 Valdimar Bjorn Asgeirsson
# SPDX-License-Identifier: MIT

## The right side has the Pimoroni trackball, so it must be the central side
# if SHIELD_AURYL_RIGHT
if SHIELD_AURYL_LEFT

config ZMK_KEYBOARD_NAME
	default "Auryl"

config ZMK_SPLIT_BLE_ROLE_CENTRAL
	default y

endif

if SHIELD_AURYL_LEFT || SHIELD_AURYL_RIGHT

config ZMK_SPLIT
	default y

endif
```

## config/boards/shields/auryl/Kconfig.shield
```kconfig
# Copyright (c) 2021 Valdimar Bjorn Asgeirsson
# SPDX-License-Identifier: MIT

config SHIELD_AURYL_LEFT
    def_bool $(shields_list_contains,auryl_left)

config SHIELD_AURYL_RIGHT
    def_bool $(shields_list_contains,auryl_right)
```

## config/west.yml
```yaml
manifest:
  remotes:
    - name: zmkfirmware
      url-base: https://github.com/zmkfirmware
    - name: genkobar
      url-base: https://github.com/genkobar
    - name: cdc
      url-base: https://github.com/cdc-mkb
    - name: w84miracle
      url-base: https://github.com/w84miracle
    - name: genkobar
      url-base: https://github.com/genkobar
  projects:
    - name: zmk
      remote: genkobar
      revision: split-encoder
      import: app/west.yml
  self:
    path: config
```
